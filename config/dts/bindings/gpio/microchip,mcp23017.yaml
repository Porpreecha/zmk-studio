## config/dts/bindings/gpio/microchip,mcp23017.yaml
```yaml
# SPDX-License-Identifier: Apache-2.0

description: Microchip MCP23017 I/O Expander (16-bit I2C GPIO)

compatible: "microchip,mcp23017"

include:
  - i2c-device.yaml
  - gpio-controller.yaml

properties:
  gpio-controller:
    type: boolean
    required: true

  "#gpio-cells":
    type: int
    const: 2
    required: true
    description: Number of cells in GPIO specifier

  ngpios:
    type: int
    const: 16
    required: true

  int-gpios:
    type: phandle-array
    description: Optional interrupt pin connection.

  interrupt-controller:
    type: boolean
    description: Device also provides an interrupt controller

  microchip,hw-reset-gpios:
    type: phandle-array
    description: Optional reset pin

  microchip,io-defaults:
    type: int
    description: Initial I/O direction mask (1=input, 0=output)

  microchip,output-defaults:
    type: int
    description: Initial output state mask (1=high, 0=low)

  microchip,pullups:
    type: int
    description: Internal pull-up enable mask (1=enabled)

  microchip,polarity:
    type: int
    description: Input polarity inversion mask (1=inverted)

  microchip,drive-strength:
    type: int
    enum: [0, 1] # 0=open-drain, 1=push-pull
    description: Output driver mode

gpio-cells:
  - pin
  - flags
```
